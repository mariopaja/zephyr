## boards/arduino/giga_r1/arduino_giga_r1_stm32h747xx_m7_defconfig
```kconfig
# Copyright 2023 Google LLC
# SPDX-License-Identifier: Apache-2.0

# Enable GPIO
CONFIG_GPIO=y

# Enable MPU
CONFIG_ARM_MPU=y

# Enable HW stack protection
CONFIG_HW_STACK_PROTECTION=y

# On M7, USB CDC ACM is used as the UART console backend by default
CONFIG_SERIAL=y
CONFIG_CONSOLE=y
CONFIG_UART_CONSOLE=y
CONFIG_STDOUT_CONSOLE=y
CONFIG_UART_LINE_CTRL=y

CONFIG_USB_DEVICE_STACK_NEXT=y
CONFIG_CDC_ACM_SERIAL_INITIALIZE_AT_BOOT=y
CONFIG_CDC_ACM_SERIAL_PID=0x0004
CONFIG_CDC_ACM_SERIAL_PRODUCT_STRING="Arduino GIGA R1 Cortex-M7"
```

## boards/st/nucleo_f429zi/dts/bindings/mikroe,board-init.yaml
```yaml
description: MCU Card 4 for STM32

compatible: "mikroe,board-init"

include: "pinctrl-device.yaml"

properties:
  
  usb-psw-gpios:
    type: phandle-array
    required: true
    description: |
      GPIOs for USB power switch control.
      LOW logic level (0) : USB HOST
      HIGH logic level (1): USB DEVICE
```

## boards/waveshare/esp32s3_lcd_1_47/Kconfig
```kconfig
# Copyright (c) 2025 Mario Paja
# SPDX-License-Identifier: Apache-2.0

config HEAP_MEM_POOL_ADD_SIZE_BOARD
	int
	default 4096 if BOARD_ESP32S3_LCD_1_47_ESP32S3_PROCPU
	default 256 if BOARD_ESP32S3_LCD_1_47_ESP32S3_APPCPU
```

## boards/waveshare/esp32s3_lcd_1_47/Kconfig.defconfig
```kconfig
# Copyright (c) 2025 Mario Paja
# SPDX-License-Identifier: Apache-2.0

if BOARD_ESP32S3_LCD_1_47_ESP32S3_PROCPU

config KERNEL_MEM_POOL
	default y

config PWM
	default y if DISPLAY

configdefault LV_COLOR_16_SWAP
	default y if LVGL

endif # BOARD_ESP32S3_LCD_1_47_ESP32S3_PROCPU
```

## boards/waveshare/esp32s3_lcd_1_47/Kconfig.esp32s3_lcd_1_47
```kconfig
# Copyright (c) 2025 Mario Paja
# SPDX-License-Identifier: Apache-2.0

config BOARD_ESP32S3_LCD_1_47
	select SOC_ESP32S3_R2
	select SOC_ESP32S3_PROCPU if BOARD_ESP32S3_LCD_1_47_ESP32S3_PROCPU
	select SOC_ESP32S3_APPCPU if BOARD_ESP32S3_LCD_1_47_ESP32S3_APPCPU
```

## boards/waveshare/esp32s3_lcd_1_47/board.yml
```yaml
board:
  name: esp32s3_lcd_1_47
  full_name: ESP32-S3-LCD-1.47
  vendor: waveshare
  socs:
  - name: esp32s3
```

## boards/waveshare/esp32s3_lcd_1_47/esp32s3_lcd_1_47_esp32s3_appcpu_defconfig
```kconfig
# Copyright (c) 2025 Mario Paja
# SPDX-License-Identifier: Apache-2.0

CONFIG_CLOCK_CONTROL=y
```

## drivers/display/Kconfig.nv3030b
```kconfig
# ST7789V display driver configuration options

# Copyright (c) 2019 Marc Reilly <marc@cpdesign.com.au>
# SPDX-License-Identifier: Apache-2.0

menuconfig NV3030B
	bool "NV3030B display driver"
	default y
	depends on DT_HAS_NVU_NV3030B_ENABLED
	select MIPI_DBI
	help
	  Enable driver for NV3030B display driver.

choice ST7789V_PIXEL_FORMAT
	prompt "Color pixel format"
	default ST7789V_RGB565
	depends on NV3030B
	help
	  Specify the color pixel format for the ST7789V display controller.

config ST7789V_RGB888
	bool "RGB888"

config ST7789V_RGB565
	bool "RGB565"

config ST7789V_RGB565X
	bool "RGB565X"

endchoice
```

## dts/bindings/audio/wolfson,wm8904.yaml
```yaml
# Copyright 2024 NXP
# SPDX-License-Identifier: Apache-2.0

description: WM8904 audio codec

include: [i2c-device.yaml]

compatible: "wolfson,wm8904"

properties:
  reg:
    required: true
  clock-source:
    type: string
    default: "MCLK"
    description: |
      Codec's internal clock signal (SYSCLK) source selection. These options
      are available:
      - "MCLK": WM8904's MCLK pin (supplied by the host)
      - "FLL":  WM8904's FLL facility, can be free-running
      The "MCLK" option is default, as this clock signal is usually supplied
      by the host.
    enum:
      - "MCLK"
      - "FLL"
  fll-ref-clk:
    type: int
    description: |
      FLL reference clock frequency in Hz. This property is required when
      the "clock-source" property is set to "FLL". The FLL reference clock
      is supplied by the host and is used to generate the codec's internal
      clock signal (SYSCLK).
  input-pga-select:
    type: int
    default: 2
    enum: [1, 2, 3]
    description: |
      Selects the WM8904 input PGA source channel.
      Only single-ended input mode is supported.
      On the 32-pin QFN package, only channels 1 and 2 are supported.
```

## dts/bindings/display/nvu,nv3030b.yaml
```yaml
# Copyright (c) 2026 Mario Paja
# SPDX-License-Identifier: Apache-2.0

title: Shanghai NewVision Microelectronics NV3030B display controller

description: |
    The NV3030B is a 262K-color (18-bit) a-Si TFT-LCD controller/driver
    with an internal GRAM supporting up to 240RGB x 320 resolution.

compatible: "nvu,nv3030b"

include: [mipi-dbi-spi-device.yaml, display-controller.yaml]

properties:
  x-offset:
    type: int
    required: true
    description: The column offset in pixels of the LCD to the controller memory

  y-offset:
    type: int
    required: true
    description: The row offset in pixels of the LCD to the controller memory

  mdac:
    type: int
    required: true
    description: Memory Data Access Control

  lcm:
    type: int
    required: true
    description: LCM Setting

  colmod:
    type: int
    required: true
    description: Interface Pixel Format

  gamma:
    type: int
    required: true
    description: Gamma Setting

  inversion-off:
    type: boolean
    description: Inversion Off

  porch-param:
    type: uint8-array
    required: true
    description: Porch Setting

  dvdd-param:
    type: uint8-array
    required: true
    description: Power Control 1 Parameter

  bias-param:
    type: uint8-array
    required: true
    description: Power Control 1 Parameter

  vgl-param:
    type: uint8-array
    required: true
    description: Power Control 1 Parameter

  vgh-param:
    type: uint8-array
    required: true
    description: Power Control 1 Parameter

  vsp-param:
    type: uint8-array
    required: true
    description: Power Control 1 Parameter

  vsn-param:
    type: uint8-array
    required: true
    description: Power Control 1 Parameter

  pump-ck-param:
    type: uint8-array
    required: true
    description: Power Control 1 Parameter

  pump-ck-param:
    type: uint8-array
    required: true
    description: Power Control 1 Parameter

  gam-ref1-param:
    type: uint8-array
    required: true
    description: Power Control 1 Parameter

  frate-param:
    type: uint8-array
    required: true
    description: Power Control 1 Parameter

  dpolctrl:
    type: int
    required: true
    description: Gamma Setting

  dfunc-param:
    type: uint8-array
    required: true
    description: Power Control 1 Parameter

  gam-p3-param:
    type: uint8-array
    required: true
    description: Power Control 1 Parameter

  gam-n3-param:
    type: uint8-array
    required: true
    description: Power Control 1 Parameter

  gam-p2-param:
    type: uint8-array
    required: true
    description: Power Control 1 Parameter

  gam-n2-param:
    type: uint8-array
    required: true
    description: Power Control 1 Parameter

  gam-p1-param:
    type: uint8-array
    required: true
    description: Power Control 1 Parameter

  gam-n1-param:
    type: uint8-array
    required: true
    description: Power Control 1 Parameter

  src1-param:
    type: uint8-array
    required: true
    description: Power Control 1 Parameter

  src2-param:
    type: uint8-array
    required: true
    description: Power Control 1 Parameter

  src3-param:
    type: uint8-array
    required: true
    description: Power Control 1 Parameter

  gate-timing:
    type: int
    required: true
    description: Gamma Setting

  tear-param:
    type: uint8-array
    required: true
    description: Power Control 1 Parameter

  iface-param:
    type: uint8-array
    required: true
    description: Power Control 1 Parameter  

  mipi-mode:
    required: true
```

## tests/drivers/i2s/i2s_speed/boards/nucleo_u575zi_q.conf
```kconfig
CONFIG_HEAP_MEM_POOL_SIZE=4192
CONFIG_I2S_TEST_SEPARATE_DEVICES=y
CONFIG_I2S_TEST_USE_GPIO_LOOPBACK=y
CONFIG_I2S_TEST_USE_I2S_DIR_BOTH=n
# CONFIG_I2S_STM32_SAI_BLOCK_COUNT=10
# CONFIG_I2S_TEST_ALLOW_VARIABLE_OFFSET=y
# CONFIG_I2S_TEST_ALLOWED_DATA_OFFSET=20

CONFIG_I2S_TEST_SKIP_SAMPLERATE_8000=y
CONFIG_I2S_TEST_SKIP_SAMPLERATE_16000=y
CONFIG_I2S_TEST_SKIP_SAMPLERATE_32000=y
CONFIG_I2S_TEST_SKIP_SAMPLERATE_48000=y
CONFIG_I2S_TEST_SKIP_SAMPLERATE_88200=y
CONFIG_I2S_TEST_SKIP_SAMPLERATE_96000=y
```
