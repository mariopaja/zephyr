## boards/mikroe/uni_clicker/dts/bindings/mikroe,board-init.yaml
```yaml
# Copyright (c) 2025 Mario Paja
# SPDX-License-Identifier: Apache-2.0

description: MikroE UNI Clicker USB power switch and ID control

compatible: "mikroe,board-init"

include: base.yaml

properties:
  usb-psw-gpios:
    type: phandle-array
    required: true
    description: |
      GPIOs for USB power switch control.
      LOW logic level (0) : USB HOST
      HIGH logic level (1): USB DEVICE

  usb-id-gpios:
    type: phandle-array
    required: true
    description: |
      USB ID pin is used to detect the type of the device attached to the USB port
      LOW logic level (0) : USB HOST
      HIGH logic level (1): USB DEVICE
```

## boards/mikroe/uni_clicker/dts/bindings/mikroe,mcu-card-connector.yaml
```yaml
# Copyright (c) 2025 Mario Paja
# SPDX-License-Identifier: Apache-2.0

description: GPIO pins exposed on MikroE MCU card connectors.

compatible: "mikroe,mcu-card-connector"

include: [gpio-nexus.yaml, base.yaml]
```

## drivers/ethernet/Kconfig.lan865x
```kconfig
# Copyright (c) 2023 DENX Software Engineering GmbH
# SPDX-License-Identifier: Apache-2.0

menuconfig ETH_LAN865X
	bool "LAN865X 10BASE-T1S Controller"
	default y
	depends on DT_HAS_MICROCHIP_LAN865X_ENABLED
	select SPI
	select NET_L2_ETHERNET_MGMT
	help
	  The LAN865X is a low power, 10BASE-T1S transceiver compliant with
	  the IEEE® 802.3cg-2019™ Ethernet standard for long reach, 10
	  Mbps single pair Ethernet (SPE).

	  Featuring an integrated media access control (MAC) and a PHY,
	  the LAN865X enables direct connectivity with a variety of controllers
	  via a serial peripheral inter-face (SPI).

if ETH_LAN865X

config ETH_LAN865X_INIT_PRIORITY
	int "LAN865X driver init priority"
	default 50
	help
	  LAN865X device driver initialization priority.
	  Must be initialized after SPI.


config ETH_LAN865X_IRQ_THREAD_STACK_SIZE
	int "Stack size for a thread that processes IRQ"
	default 512
	help
	  Size of the stack used for internal thread which is ran to
	  process raised INT IRQ.

config ETH_LAN865X_IRQ_THREAD_PRIO
	int "Priority for internal incoming packet handler"
	default 2
	help
	  Priority level for internal thread which is ran for LAN
	  INT IRQ processing.

config ETH_LAN865X_TIMEOUT
	int "IP buffer timeout"
	default 100
	help
	  Given timeout in milliseconds. Maximum amount of time
	  that the driver will wait from the IP stack to get
	  a memory buffer.

config PTP_CLOCK_LAN865X
	bool "LAN865X PTP clock driver support"
	default y
	depends on PTP_CLOCK
	select NET_L2_PTP_TIMESTAMPING
	help
	  Enable the LAN865X TSU timer as PTP clock and the timestamping of
	  frames. Ingress timestamps are added by the device to all received
	  frames, egress timestamps are captured for the frames that request
	  one. Both are taken at the end of the SFD on the MDI, so they are
	  not affected by the PLCA transmit opportunity delay.

endif # ETH_LAN865X
```

## drivers/ethernet/Kconfig.lan9250
```kconfig
# LAN9250 Stand-alone Ethernet Controller configuration options

# Copyright (c) 2024 Mario Paja
# SPDX-License-Identifier: Apache-2.0


menuconfig ETH_LAN9250
	bool "LAN9250 Ethernet Controller"
	default y
	depends on DT_HAS_MICROCHIP_LAN9250_ENABLED
	select GPIO
	select SPI if $(dt_compat_on_bus,$(DT_COMPAT_MICROCHIP_LAN9250),spi)
	select MSPI if $(dt_compat_on_bus,$(DT_COMPAT_MICROCHIP_LAN9250),mspi)
	help
	  LAN9250 Stand-Alone Ethernet Controller
	  with SPI Interface, connected to an SPI or MSPI controller

if ETH_LAN9250

config ETH_LAN9250_RX_THREAD_STACK_SIZE
	int "Stack size for internal incoming packet handler"
	default 1024
	help
	  Size of the stack used for internal thread which is ran for
	  incoming packet processing. The thread handles all device
	  interrupts, including PHY and MAC register accesses over SPI.
	  Increase it when NET_TC_RX_COUNT is 0, as received packets are
	  then processed by the network stack in this thread.

config ETH_LAN9250_RX_THREAD_PRIO
	int "Priority for internal incoming packet handler"
	default 2
	help
	  Priority level for internal thread which is ran for incoming
	  packet processing.

config ETH_LAN9250_SPI_FAST_READ
	bool "Use the SPI Fast Read instruction"
	default y
	help
	  Read registers and the RX data FIFO with the SPI Fast Read
	  instruction (0x0B), which supports SPI clock rates up to 80 MHz.
	  The Read instruction (0x03) is limited to 30 MHz. Fast Read adds
	  one dummy byte to each read transfer. Only used for devices on an
	  SPI controller, devices on an MSPI controller always use Fast Read
	  or the dual and quad read instructions.

config ETH_LAN9250_BUF_ALLOC_TIMEOUT
	int "Network buffer allocation timeout"
	default 100
	help
	  Given timeout in milliseconds. Maximum amount of time
	  that the driver will wait from the IP stack to get
	  a memory buffer before the Ethernet frame is dropped.

endif
```

## drivers/i2s/Kconfig.stm32
```kconfig
# STM32 I2S driver configuration options

# Copyright (c) 2018 STMicroelectronics
# SPDX-License-Identifier: Apache-2.0

menuconfig I2S_STM32
	bool "STM32 MCU I2S controller driver"
	default y
	depends on DT_HAS_ST_STM32_I2S_ENABLED
	select CACHE_MANAGEMENT if DCACHE
	select DMA
	select PINCTRL
	help
	  Enable I2S support on the STM32 family of processors.
	  (Tested on the STM32F4 & STM32H7 series)

if I2S_STM32

config I2S_STM32_RX_BLOCK_COUNT
	int "RX queue length"
	default 4

config I2S_STM32_TX_BLOCK_COUNT
	int "TX queue length"
	default 4

endif # I2S_STM32

menuconfig I2S_STM32_SAI
	bool "STM32 MCU SAI controller driver"
	default y
	depends on DT_HAS_ST_STM32_SAI_ENABLED
	select CACHE_MANAGEMENT if DCACHE
	select DMA
	select USE_STM32_HAL_DMA
	select USE_STM32_HAL_DMA_EX
	select USE_STM32_HAL_SAI
	select USE_STM32_HAL_SAI_EX if SOC_SERIES_STM32F4X
	help
	  Enable SAI support on the STM32 family of processors.

if I2S_STM32_SAI

config I2S_STM32_SAI_BLOCK_COUNT
	int "SAI queue length"
	default 4

config I2S_STM32_SAI_PDM
	bool "PDM microphone decimation"
	help
	  The SAI PDM interface (st,sai-mode = "pdm") only captures the raw
	  PDM bitstream into the FIFO in hardware; it does not demodulate it
	  to PCM. Enable this option to link in ST's OpenPDMFilter library
	  (from the hal_st module) and decimate the raw bitstream to PCM
	  samples before handing blocks to i2s_read(). Uses roughly 50 KB of
	  RAM for filter lookup tables. Currently supports one microphone
	  pair (stereo) only.

endif # I2S_STM32_SAI
```

## dts/bindings/ethernet/microchip,lan9250-common.yaml
```yaml
# Copyright (c) 2024, Mario Paja
# SPDX-License-Identifier: Apache-2.0

# Common properties of the LAN9250, whatever host bus it is connected to

include: ethernet-controller.yaml

properties:
  int-gpios:
    type: phandle-array
    required: true
    description: |
      The interrupt pin of LAN9250 is active low.
      If connected directly the MCU pin should be configured
      as active low.

  reset-gpios:
    type: phandle-array
    description: The reset pin of LAN9250.
```

## dts/bindings/ethernet/microchip,lan9250-mspi.yaml
```yaml
# Copyright (c) 2026, Mario Paja
# SPDX-License-Identifier: Apache-2.0

description: |
    LAN9250 standalone 10/100BASE-T Ethernet controller on a multi-bit
    SPI (MSPI) controller, such as an STM32 OCTOSPI or XSPI.

    Supported values of mspi-io-mode are MSPI_IO_MODE_SINGLE (1-1-1),
    MSPI_IO_MODE_DUAL_1_1_2, MSPI_IO_MODE_DUAL_1_2_2,
    MSPI_IO_MODE_QUAD_1_1_4 and MSPI_IO_MODE_QUAD_1_4_4, at single data
    rate and in clock mode 0 or 3. The driver selects the matching read
    and write instructions, the 8 dummy clocks of the read instructions,
    a 1 byte instruction and a 2 byte address, so read-command,
    write-command, rx-dummy, command-length and address-length do not
    need to be set.

    The LAN9250 drives read data up to 11 ns after the clock edge, so
    above about 40 MHz the controller must delay its sampling point, for
    example with st,ssht-enable on an STM32 OCTOSPI or XSPI controller.

compatible: "microchip,lan9250"

include: [mspi-device.yaml, "microchip,lan9250-common.yaml"]
```

## dts/bindings/ethernet/microchip,lan9250-spi.yaml
```yaml
# Copyright (c) 2024, Mario Paja
# SPDX-License-Identifier: Apache-2.0

description: |
    LAN9250 standalone 10/100BASE-T Ethernet controller with SPI interface

compatible: "microchip,lan9250"

include: [spi-device.yaml, "microchip,lan9250-common.yaml"]
```

## dts/bindings/i2s/st,stm32-sai.yaml
```yaml
# Copyright (c) 2024 ZAL Zentrum für Angewandte Luftfahrtforschung GmbH
# SPDX-License-Identifier: Apache-2.0

description: STM32 SAI Block controller

compatible: "st,stm32-sai"

include: base.yaml

properties:
  reg:
    required: true

  ranges:
    required: true

  clock-names:
    required: true
    enum:
      - "sai_ck"
      - "sai_ker_ck"
      - "sai_b_ker_ck"
    description: |
      Expected names are the following:
      - "sai_ck" for configuring the peripheral bus clock
      - "sai_ker_ck" for configuring a shared SAI or dedicated SAI A kernel clock
      - "sai_b_ker_ck" for configuring a dedicated SAI B kernel clock

      Depending on the platform, SAI A and SAI B may either share a single
      kernel clock selector or have independent selectors.

      - Platforms with independent kernel clock selectors must provide the kernel clock
      corresponding to each enabled SAI node.
      For example, "sai_ker_ck" is required for SAI A and "sai_b_ker_ck" for SAI B.

      - Platforms with a shared kernel clock selector only need to provide "sai_ker_ck",
      which applies to both SAI A and SAI B.

  "#address-cells":
    const: 1

  "#size-cells":
    const: 1

child-binding:
  description: SAI Sub-Block instances linked to SAI Block Controller

  include:
    - name: pinctrl-device.yaml
    - name: i2s-controller.yaml
      property-blocklist: [compatible]

  properties:
    reg:
      required: true

    dmas:
      required: true

    dma-names:
      required: true
      description: |
        DMA channel name: "tx" or "rx", depending of expected device behavior.
      enum: [tx, rx]

    pinctrl-0:
      required: true

    pinctrl-names:
      required: true

    mclk-enable:
      type: boolean
      description: |
        Master Clock Output function.
        An mck pin must be listed within pinctrl-0 when enabling this property.

    mclk-divider:
      type: string
      default: "no-div"
      description: |
        Master Clock Divider Configuration.

        When no-div property is present:
        - MCKDIV = SAI_CK_x / (FS * (FRL + 1))
        Otherwise:
        - MCKDIV = SAI_CK_x / (FS * (OSR + 1) * 256)

        When div-256 is present OSR is set to 0.
        When div-512 is present OSR is set to 1.
      enum:
        - "no-div"
        - "div-256"
        - "div-512"

    synchronous:
      type: boolean
      description: |
        Synchronous mode.
        When present, the SAI controller is configured to work in synchronous mode.

    fifo-threshold:
      type: string
      default: "full"
      description: |
        SAI Block Fifo Threshold defines the fill level at which the peripheral
        triggers a DMA request or interrupt to transfer data
      enum:
        - "empty"
        - "1/4"
        - "1/2"
        - "3/4"
        - "full"

    st,sai-mode:
      type: string
      default: "i2s"
      description: |
        SAI Block operating mode.
        - "i2s": standard I2S/PCM audio interface (default).
        - "pdm": PDM microphone interface. The block demodulates one or more
          PDM bitstreams into PCM samples in hardware. Only usable on a
          sub-block that carries the st,sai-pdm-capable property (set at the
          SoC devicetree level on whichever specific SAI instance/block the
          silicon wires up for PDM, e.g. SAI1 block A on STM32H5).
      enum:
        - "i2s"
        - "pdm"

    st,sai-pdm-capable:
      type: boolean
      description: |
        Marks this specific SAI sub-block as wired in silicon to the PDM
        microphone interface. PDM support is not a property of "block A" in
        general: on a given SoC, only one specific SAI instance/block
        implements it (e.g. SAI1 block A, never SAI2/SAI3/SAI4 block A).
        This property belongs in the SoC-level devicetree, not in a board
        overlay, and gates whether st,sai-mode = "pdm" is accepted.

    st,sai-pdm-mic-pairs:
      type: int
      default: 1
      description: |
        Number of PDM microphone pairs to capture. Each pair is demodulated
        into one stereo PCM channel. Only relevant when st,sai-mode = "pdm".
      enum:
        - 1
        - 2
        - 3

    st,sai-pdm-clock:
      type: string
      default: "clock1"
      description: |
        PDM clock output(s) driving the microphones (SAI_CKx pins).
        "clock1" enables CK1 only, "clock2" enables CK2 only, and "both"
        enables CK1 and CK2 together. CK2 is only needed when capturing
        more microphone pairs than a single clock domain supports. Only
        relevant when st,sai-mode = "pdm".
      enum:
        - "clock1"
        - "clock2"
        - "both"

    st,sai-pdm-volume:
      type: int
      default: 16
      description: |
        Runtime gain applied by the PDM->PCM decimation filter (ST's
        OpenPDMFilter, when CONFIG_I2S_STM32_SAI_PDM=y), relative to its
        fixed full-scale reference of 64. Valid range 0-64; higher values
        increase gain and clipping risk. Tune per microphone
        sensitivity/wiring. Only relevant when st,sai-mode = "pdm".

    st,sai-pdm-mono:
      type: boolean
      description: |
        Only one channel of the mic pair (see st,sai-pdm-mono-channel) is
        physically wired to a real microphone. When set, the PDM->PCM
        decimation filter (CONFIG_I2S_STM32_SAI_PDM=y) only processes that
        channel and delivers compact mono PCM, instead of interleaved
        stereo with noise/garbage in the other channel's slots. Only
        relevant when st,sai-mode = "pdm".

    st,sai-pdm-mono-channel:
      type: string
      default: "a"
      description: |
        Which channel of the mic pair the real microphone is wired to, in
        mono mode (st,sai-pdm-mono). PDM mics that share a clock/data bus
        pick their slot via a SEL/L-R pin: "a" is the first slot (mic's
        SEL tied for the falling/first edge), "b" is the second. Getting
        this wrong means decoding an undriven slot -- plausible-looking
        but meaningless PCM (no real audio content), not silence or an
        obvious error. Only relevant when st,sai-mode = "pdm" and
        st,sai-pdm-mono is set.
      enum:
        - "a"
        - "b"
```
