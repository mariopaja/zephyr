&spi2 {
    cs-gpios=<&gpio0 2 GPIO_ACTIVE_LOW>;
    eth_lan9250: eth_lan9250@0 {
        compatible = "microchip,lan9250";
        spi-max-frequency = <20000000>; // SPI frequency
        reg = <0>; 
        int-gpios = <&gpio0 4 GPIO_ACTIVE_LOW>; 
        status = "okay";
        local-mac-address = [80 34 28 01 02 03];
    };
};
